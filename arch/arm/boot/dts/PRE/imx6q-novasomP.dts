/*
 * Copyright 2013 Freescale Semiconductor, Inc.
 *
 * Author: Fabio Estevam <fabio.estevam@freescale.com>
 *
 * This program is free software; you can redistribute it and/or modify
 * it under the terms of the GNU General Public License version 2 as
 * published by the Free Software Foundation.
 *
 */
/dts-v1/;
#include "imx6q.dtsi"
#include "imx6q-novasomP.dtsi"

/ {
	model = "NOVAsomP i.MX6 Quad Board";
	compatible = "novasomp,imx6q-udoo", "fsl,imx6q";
};

&sata {
	status = "okay";
};
